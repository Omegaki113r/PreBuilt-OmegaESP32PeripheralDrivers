## OmegaBluetoothController/Kconfig
```kconfig
menu "OmegaBLEController Configuration"
    config BLE_DEBUG
        bool "Enable BLE Debugging"
        default "y"
        help
            This is used to enable or disable debug logs
endmenu
```

## OmegaBluetoothController/OmegaLEController/Kconfig
```kconfig
menu "OmegaBLEController Configuration"
    config OMEGA_BLE_DEBUG
        bool "Enable BLE Debugging"
        default "y"
        help
            This is used to enable or disable debug logs
endmenu
```

## OmegaWiFiController/Kconfig
```kconfig
menu "OmegaWiFiController Configuration"
    config WIFI_DEBUG
        bool "Enable WIFI Debugging"
        default "y"
        help
            This is used to enable or disable debug logs
endmenu
```
